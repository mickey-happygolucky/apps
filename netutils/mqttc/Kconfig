## netutils/mqttc/Kconfig
```kconfig
#
# For a description of the syntax of this configuration file,
# see the file kconfig-language.txt in the NuttX tools repository.
#

config NETUTILS_MQTTC
	bool "MQTTC client library"
	default n
	depends on NET && NET_TCP
	---help---
		Enable support for the mqtt.  This is a public domain
		Telnet client library available from https://github.com/LiamBindle/MQTT-C
		modified for use with NuttX.  Original Authors:

			Liam Bindle
			Demilade Adeoye

if NETUTILS_MQTTC
endif
```

## system/mqttc/Kconfig
```kconfig
#
# For a description of the syntax of this configuration file,
# see the file kconfig-language.txt in the NuttX tools repository.
#

config SYSTEM_MQTTC
	bool "'mqttc' command"
	default n
	depends on NET
	---help---
		Enable support for the 'mqttc' command.

if SYSTEM_MQTTC
config SYSTEM_MQTTC_PROGNAME
	string "MQTTC program name"
	default "mqttc"
	depends on BUILD_KERNEL
	---help---
		This is the name of the program that will be use when the NSH ELF
		program is installed.

config SYSTEM_MQTTC_PRIORITY
	int "MQTTC task priority"
	default 100

config SYSTEM_MQTTC_STACKSIZE
	int "MQTTC stack size"
	default 8192

endif
```
